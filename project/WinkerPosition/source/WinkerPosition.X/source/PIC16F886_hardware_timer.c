/*******************************************************************************
*	Author		|	Date		|	FileName
*-------------------------------------------------------------------------------
*	kenchaan	|	2020/01/16	|	PIC16F886_hardware_timer.c
*-------------------------------------------------------------------------------
*	Description	|	[PIC16F886]タイマ制御
*-------------------------------------------------------------------------------
*	Copyright (c) 2020 kenchaan All Rights Reserved.
*******************************************************************************/

/*------------------------------------------------------------------------------
*	include
*-----------------------------------------------------------------------------*/
#include <xc.h>
#include "types.h"
#include "regaccess.h"
#include "hardware_interrupt.h"
#include "hardware_timer.h"

/*------------------------------------------------------------------------------
*	pragma
*-----------------------------------------------------------------------------*/


/*------------------------------------------------------------------------------
*	define
*-----------------------------------------------------------------------------*/


/*------------------------------------------------------------------------------
*	macro
*-----------------------------------------------------------------------------*/


/*------------------------------------------------------------------------------
*	typedef
*-----------------------------------------------------------------------------*/


/*------------------------------------------------------------------------------
*	enum
*-----------------------------------------------------------------------------*/


/*------------------------------------------------------------------------------
*	struct
*-----------------------------------------------------------------------------*/


/*------------------------------------------------------------------------------
*	static variable
*-----------------------------------------------------------------------------*/


/*------------------------------------------------------------------------------
*	static function prototype
*-----------------------------------------------------------------------------*/


/*------------------------------------------------------------------------------
*	static const data
*-----------------------------------------------------------------------------*/


/*------------------------------------------------------------------------------
*	extern const data
*-----------------------------------------------------------------------------*/


/*------------------------------------------------------------------------------
*	function
*-----------------------------------------------------------------------------*/

/*------------------------------------------------------------------------------
* OverView	: タイマ初期化
* Parameter	: None
* Return	: None
*-----------------------------------------------------------------------------*/
void HW_TIM_Initialize( void)
{
	/* TMR0設定(フレーム処理用) */
	/* 20MHz,1:32,100 → 0.9984msec */
	REG_RMW_08( OPTION_REG, 0x3F, 0x04 );
	REG_WRITE_08( TMR0, TMR0_DEFAULT );
	REG_SET_08( INTCON, 0x20 );

	/* TMR2設定(PWM用) */
	/* 20MHz,1:2,249 → 0.1msec */
	REG_WRITE_08( PR2, TMR2_PERIOD );
	REG_WRITE_08( T2CON, 0x08 );
	REG_SET_08( PIE1, 0x02 );
}

/*------------------------------------------------------------------------------
* OverView	: タイマ処理開始
* Parameter	: None
* Return	: None
*-----------------------------------------------------------------------------*/
void HW_TIM_StartProcess( void )
{
	/* TMR0クリア */
	REG_WRITE_08( TMR0, TMR0_DEFAULT );

	/* TMR1クリア */
	REG_WRITE_08( TMR2, TMR2_DEFAULT );
}

/*------------------------------------------------------------------------------
* OverView	: タイマ有効/無効設定
* Parameter	: eType		: タイマ種別
* 			: isEnable	: TRUE:有効 FALSE:無効
* Return	: None
*-----------------------------------------------------------------------------*/
void HW_TIM_EnableTimer( CE_TIMER_TYPE eType, const BOOL isEnable )
{
	if( isEnable ){
		switch( eType ){
		case eTIMER_TYPE_PWM:
			REG_SET_08( T2CON, 0x04 );
			break;
		default:
			break;
		}

	}else{
		switch( eType ){
		case eTIMER_TYPE_PWM:
			REG_CLR_08( T2CON, 0x04 );
			break;
		default:
			break;
		}
	}

}


/*------------------------------------------------------------------------------
*	End Of File
*-----------------------------------------------------------------------------*/
