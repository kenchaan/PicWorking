/*******************************************************************************
*	Author		|	Date		|	FileName
*-------------------------------------------------------------------------------
*	kenchaan	|	2019/01/22	|	PIC16F886_hardware_timer.c
*-------------------------------------------------------------------------------
*	Description	|	[PIC16F886]タイマ制御
*-------------------------------------------------------------------------------
*	Copyright (c) 2019 kenchaan All Rights Reserved.
*******************************************************************************/

/*------------------------------------------------------------------------------
*	include
*-----------------------------------------------------------------------------*/
#include <xc.h>
#include "types.h"
#include "regaccess.h"
#include "hardware_timer.h"

/*------------------------------------------------------------------------------
*	pragma
*-----------------------------------------------------------------------------*/


/*------------------------------------------------------------------------------
*	define
*-----------------------------------------------------------------------------*/


/*------------------------------------------------------------------------------
*	macro
*-----------------------------------------------------------------------------*/


/*------------------------------------------------------------------------------
*	typedef
*-----------------------------------------------------------------------------*/


/*------------------------------------------------------------------------------
*	enum
*-----------------------------------------------------------------------------*/


/*------------------------------------------------------------------------------
*	struct
*-----------------------------------------------------------------------------*/


/*------------------------------------------------------------------------------
*	static variable
*-----------------------------------------------------------------------------*/
static volatile U32 g_u32TimerCount_Ary[ eTIMER_TYPE_MAX ];

/*------------------------------------------------------------------------------
*	static function prototype
*-----------------------------------------------------------------------------*/


/*------------------------------------------------------------------------------
*	static const data
*-----------------------------------------------------------------------------*/


/*------------------------------------------------------------------------------
*	extern const data
*-----------------------------------------------------------------------------*/


/*------------------------------------------------------------------------------
*	function
*-----------------------------------------------------------------------------*/

/*------------------------------------------------------------------------------
* OverView	: タイマ初期化
* Parameter	: None
* Return	: None
*-----------------------------------------------------------------------------*/
void HW_TIM_Initialize( void)
{
	/* TMR0設定(フレーム処理用) */
	/* 20MHz,1:256,61 → 9.984msec */
	REG_RMW_08( OPTION_REG, 0x3F, 0x07 );
	REG_WRITE_08( TMR0, TMR0_DEFAULT );
	REG_SET_08( INTCON, 0x20 );

	/* TMR1設定(時間カウント用) */
	/* 32.768kHz(External),1:1,32768 → 1.0sec */
	REG_WRITE_08( T1CON, 0x0B );
	//REG_WRITE_08( T1CON, 0x01 );
	//REG_WRITE_16( TMR1, TMR1_DEFAULT );
	REG_WRITE_08( TMR1H, 0x80 );
	REG_SET_08( PIE1, 0x01 );
}

/*------------------------------------------------------------------------------
* OverView	: タイマ処理開始
* Parameter	: None
* Return	: None
*-----------------------------------------------------------------------------*/
void HW_TIM_StartProcess( void )
{
	/* TMR0クリア */
	REG_WRITE_08( TMR0, TMR0_DEFAULT );

	/* TMR1クリア */
	//REG_WRITE_16( TMR1, TMR1_DEFAULT );
	REG_WRITE_08( TMR1H, 0x80 );

	for( E_TIMER_TYPE e = eTIMER_TYPE_MIN; e < eTIMER_TYPE_MAX; e++ ){
		g_u32TimerCount_Ary[ e ] = 0;
	}
}

/*------------------------------------------------------------------------------
* OverView	: タイマ取得
* Parameter	: index	: タイマインデックス
* Return	: None
*-----------------------------------------------------------------------------*/
U32 HW_TIM_GetCount( CE_TIMER_TYPE index )
{
	return g_u32TimerCount_Ary[ index ];
}

/*------------------------------------------------------------------------------
* OverView	: タイマクリア
* Parameter	: index	: タイマインデックス
* Return	: None
*-----------------------------------------------------------------------------*/
void HW_TIM_Clear( CE_TIMER_TYPE index )
{
	g_u32TimerCount_Ary[ index ] = 0;
}

/*------------------------------------------------------------------------------
* OverView	: タイマ周期処理
* Parameter	: index	: タイマインデックス
* Return	: None
*-----------------------------------------------------------------------------*/
void HW_TIM_Interrupt( CE_TIMER_TYPE index )
{
	if( g_u32TimerCount_Ary[ index ] < 0xFFFFFFFF ){
		g_u32TimerCount_Ary[ index ]++;
	}

	if( index == eTIMER_TYPE_TIME ){
		if( g_u32TimerCount_Ary[ index ] % 2 == 0 ){
			REG_CLR_08( PORTB, 0x04 );
		}else{
			REG_SET_08( PORTB, 0x04 );
		}
	}
}


/*------------------------------------------------------------------------------
*	End Of File
*-----------------------------------------------------------------------------*/
